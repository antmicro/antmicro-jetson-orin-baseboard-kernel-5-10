/*
 * Top level DTS file for CVM:P3767-0003/P3767-0005 and CVB:antmicro-job.
 *
 * Copyright (c) 2021-2022, NVIDIA CORPORATION.  All rights reserved.
 * Copyright (c) 2025 Antmicro <www.antmicro.com>
 *
 * This program is free software; you can redistribute it and/or modify
 * it under the terms of the GNU General Public License as published by
 * the Free Software Foundation; version 2 of the License.
 *
 * This program is distributed in the hope that it will be useful, but WITHOUT
 * ANY WARRANTY; without even the implied warranty of MERCHANTABILITY or
 * FITNESS FOR A PARTICULAR PURPOSE.  See the GNU General Public License for
 * more details.
 */

/dts-v1/;
#include "tegra234-p3767-0000-antmicro-job-gmsl-imx219.dts"

/ {
	nvidia,dtsfilename = __FILE__;
	nvidia,dtbbuildtime = __DATE__, __TIME__;
	compatible = "nvidia,p3509-0000+p3767-0003", "nvidia,p3509-0000+p3767-0005",
			"nvidia,p3767-0003", "nvidia,p3767-0005",
			"nvidia,tegra234", "nvidia,tegra23x";
	model = "NVIDIA Orin Nano 8GB SoM on Antmicro Jetson Orin Baseboard with GMSL Deserializer + 4xGMSL Serializer + 4xIMX219";
};
